## grove_lcd/Kconfig
```kconfig
menu "Grove LCD RGB Backlight v4.0 Configuration"
    config GROVE_LCD_I2C_NUM
        int "I2C Port Number"
        default 0
        help
            I2C port number for Grove LCD

    config GROVE_LCD_I2C_SDA
        int "SDA GPIO Number"
        default 2
        help
            GPIO number for I2C SDA signal

    config GROVE_LCD_I2C_SCL
        int "SCL GPIO Number"
        default 1
        help
            GPIO number for I2C SCL signal

    config GROVE_LCD_I2C_CLK_SPEED_HZ
        int "I2C Clock Speed (Hz)"
        default 100000
        help
            I2C clock speed in Hz

    config GROVE_LCD_I2C_ADDR
        hex "I2C Address (LCD)"
        default 0x3E
        help
            I2C address of Grove LCD (default: 0x3E)

    config GROVE_LCD_RGB_ADDR
        hex "I2C Address (RGB)"
        default 0x62
        help
            I2C address of Grove RGB backlight.
            Default 0x62 for PCA9632 (old version)
            Use 0x30 for SGM31323 (new version)
            Run i2c-detect or similar tool to verify actual address

endmenu
```

## hp203b/Kconfig
```kconfig
menu "Driver HP203B Sensor"
            
    menu "I2C"
        config HP203B_I2C_NUM
            int "I2C peripheral index"
            default 0
            range -1 3
            help
                For auto select I2C peripheral, set to -1.

        config HP203B_I2C_SDA
            int "I2C SDA pin"
            default 2
            range 0 55
            help
                Set the I2C SDA pin for the data signal.

        config HP203B_I2C_SCL
            int "I2C SCL pin"
            default 1
            range 0 55
            help
                Set the I2C SCL pin for the clock signal.

        config HP203B_I2C_CLK_SPEED_HZ
            int "I2C clock speed (Hz)"
            default 100000
            range 10000 400000
            help
                Set the I2C clock speed in Hz.
    endmenu
  
endmenu
```

## lis3dh/Kconfig
```kconfig
menu "LIS3DH Accelerometer Configuration"

    config LIS3DH_I2C_SDA_PIN
        int "SDA pin number"
        default 21
        help
            I2C SDA pin number for LIS3DH sensor communication.

    config LIS3DH_I2C_SCL_PIN
        int "SCL pin number"
        default 20
        help
            I2C SCL pin number for LIS3DH sensor communication.

    config LIS3DH_I2C_CLK_SPEED
        int "I2C clock speed (Hz)"
        default 400000
        range 100000 1000000
        help
            I2C clock speed in Hz. Typical range is 100kHz to 1MHz.
            Default is 400kHz (standard mode).

    choice LIS3DH_I2C_ADDRESS
        prompt "LIS3DH I2C Address"
        default LIS3DH_I2C_ADDR_HIGH
        help
            Select the I2C address based on the SA0 pin configuration.
            SA0 = 0: 0x18
            SA0 = 1: 0x19

        config LIS3DH_I2C_ADDR_LOW
            bool "0x18 (SA0 = 0)"

        config LIS3DH_I2C_ADDR_HIGH
            bool "0x19 (SA0 = 1)"

    endchoice

    config LIS3DH_I2C_ADDRESS
        hex
        default 0x18 if LIS3DH_I2C_ADDR_LOW
        default 0x19 if LIS3DH_I2C_ADDR_HIGH

endmenu
```

## max17043/Kconfig
```kconfig
menu "Max17043 Configuration"
    config MAX17043_I2C_NUM
        int "I2C Port Number"
        default 0
        help
            I2C port number for MAX17043 sensor

    config MAX17043_I2C_SDA
        int "SDA GPIO Number"
        default 21
        help
            GPIO number for I2C SDA signal

    config MAX17043_I2C_SCL
        int "SCL GPIO Number"
        default 22
        help
            GPIO number for I2C SCL signal

    config MAX17043_I2C_CLK_SPEED_HZ
        int "I2C Clock Speed (Hz)"
        default 100000
        help
            I2C clock speed in Hz

    config MAX17043_I2C_ADDR
        hex "I2C Address"
        default 0x36
        help
            I2C address of MAX17043 fuel gauge (default: 0x36)

endmenu
```

## mc3479/Kconfig
```kconfig
menu "Driver MC3479 Sensor"
            
    menu "I2C"
        config MC3479_I2C_NUM
            int "I2C peripheral index"
            default -1
            range -1 3
            help
                For auto select I2C peripheral, set to -1.

        config MC3479_I2C_SDA
            int "I2C SDA pin"
            default 2
            range 0 55
            help
                Set the I2C SDA pin for the data signal.

        config MC3479_I2C_SCL
            int "I2C SCL pin"
            default 1
            range 0 55
            help
                Set the I2C SCL pin for the clock signal.

        config MC3479_I2C_CLK_SPEED_HZ
            int "I2C clock speed (Hz)"
            default 100000
            range 10000 400000
            help
                Set the I2C clock speed in Hz.

        choice MC3479_I2C_ADDR
            prompt "MC3479 I2C address"
            default MC3479_I2C_ADDR_0
            help
                Select the I2C address based on the address selection pin state.

            config MC3479_I2C_ADDR_0
                bool "0x4C (Address pin to GND)"
            config MC3479_I2C_ADDR_1
                bool "0x6C (Address pin to VDD)"
        endchoice

        config MC3479_I2C_ADDRESS
            hex
            default 0x4C if MC3479_I2C_ADDR_0
            default 0x6C if MC3479_I2C_ADDR_1
    endmenu
  
endmenu
```

## nt3h2111/Kconfig
```kconfig
menu "Driver NT3H2111 NFC/I2C Bridge"
            
    menu "I2C"
        config NT3H2111_I2C_NUM
            int "I2C peripheral index"
            default -1
            range -1 3
            help
                For auto select I2C peripheral, set to -1.

        config NT3H2111_I2C_SDA
            int "I2C SDA pin"
            default 21
            range 0 55
            help
                Set the I2C SDA pin for the data signal.

        config NT3H2111_I2C_SCL
            int "I2C SCL pin"
            default 22
            range 0 55
            help
                Set the I2C SCL pin for the clock signal.

        config NT3H2111_I2C_CLK_SPEED_HZ
            int "I2C clock speed (Hz)"
            default 100000
            range 10000 400000
            help
                Set the I2C clock speed in Hz. Maximum is 400kHz for NT3H2111.
    endmenu

    config NT3H2111_FD_PIN
        int "Field Detection (FD) GPIO pin"
        default 19
        range -1 55
        help
            GPIO pin connected to NT3H2111 Field Detection (FD) pin.
            Set to -1 to disable hardware field detection interrupt.
            When enabled, this pin generates an interrupt when an NFC field is detected.
  
endmenu
```

## st25dv/Kconfig
```kconfig
menu "Driver ST25DV NFC/I2C EEPROM"
            
    menu "I2C"
        config ST25DV_I2C_NUM
            int "I2C peripheral index"
            default -1
            range -1 3
            help
                For auto select I2C peripheral, set to -1.

        config ST25DV_I2C_SDA
            int "I2C SDA pin"
            default 21
            range 0 55
            help
                Set the I2C SDA pin for the data signal.

        config ST25DV_I2C_SCL
            int "I2C SCL pin"
            default 22
            range 0 55
            help
                Set the I2C SCL pin for the clock signal.

        config ST25DV_I2C_CLK_SPEED_HZ
            int "I2C clock speed (Hz)"
            default 100000
            range 10000 400000
            help
                Set the I2C clock speed in Hz. Maximum is 400 kHz for ST25DV.
    endmenu

    config ST25DV_GPO_PIN
        int "GPO interrupt GPIO pin"
        default -1
        range -1 55
        help
            GPIO pin connected to ST25DV GPO (General Purpose Output) pin.
            Set to -1 to disable hardware interrupt support.
            When enabled, this pin generates interrupts for configured events
            (RF field detection, mailbox events, RF write events, etc.).

endmenu
```

## tmc2208/Kconfig
```kconfig
menu "Stepper Motor Driver TMC2208"
            
    menu "GPIO Configuration"
        config MOTOR_STEP_IO
            int "Driver step pin"
            default 5
            range -1 55
            help
                GPIO connected to the step pin. To disable, set to -1.

        config MOTOR_DIR_IO
            int "Driver direction pin"
            default 4
            range -1 55
            help
                GPIO connected to the direction pin. To disable, set to -1.

        config MOTOR_EN_IO
            int "Driver enable pin"
            default 10
            range -1 55
            help
                GPIO connected to the direction pin. To disable, set to -1.

        config MOTOR_MS1_IO
            int "Driver micro step 1 pin"
            default 6
            range -1 55
            help
                GPIO connected to the micro step 1 pin. To disable, set to -1.

        config MOTOR_MS2_IO
            int "Driver micro step 2 pin"
            default 7
            range -1 55
            help
                GPIO connected to the micro step 2 pin. To disable, set to -1.
    endmenu
  
endmenu
```

## tv-b-gone/Kconfig
```kconfig
menu "TV-B-Gone IR Configuration"

    config TVBGONE_IR_TX_GPIO
        int "IR TX GPIO pin"
        default 4
        range 0 55
        help
            GPIO pin used as IR transmitter output for the TV-B-Gone component.

endmenu
```
