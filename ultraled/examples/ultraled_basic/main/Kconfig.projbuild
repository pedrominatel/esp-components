## ultraled/examples/ultraled_basic/main/Kconfig.projbuild
```kconfig
menu "Ultraled example configuration"

config ULTRALED_EXAMPLE_CHANNEL_COUNT
    int "Number of strips"
    default 2
    range 1 2

config ULTRALED_EXAMPLE_GPIO_0
    int "First strip data GPIO"
    default 10
    range 0 54

config ULTRALED_EXAMPLE_GPIO_1
    int "Second strip data GPIO"
    default 11
    range 0 54

config ULTRALED_EXAMPLE_LED_COUNT_0
    int "First strip LED count"
    default 24
    range 1 4096

config ULTRALED_EXAMPLE_LED_COUNT_1
    int "Second strip LED count"
    default 12
    range 1 4096

endmenu
```

## ultraled/test_apps/ultraled/sdkconfig.defaults
```kconfig
CONFIG_IDF_TARGET="esp32p4"
CONFIG_ESP32P4_REV_MIN_300=y
CONFIG_UNITY_ENABLE_IDF_TEST_RUNNER=y
```

## ultraled/test_apps/ultraled_perf/sdkconfig.defaults
```kconfig
CONFIG_IDF_TARGET="esp32p4"
CONFIG_ESP32P4_REV_MIN_300=y
CONFIG_COMPILER_OPTIMIZATION_PERF=y
```

## ultraled/test_apps/ultraled_selective/sdkconfig.defaults
```kconfig
CONFIG_IDF_TARGET="esp32p4"
CONFIG_ESP_DEFAULT_CPU_FREQ_MHZ_400=y
CONFIG_COMPILER_OPTIMIZATION_PERF=y
```
